## conf/layer.conf
```bitbake
# Copyright (C) 2023 Wind River Systems, Inc.
#
BBFILE_COLLECTIONS += "wrlinux-src-dl"
BBFILE_PATTERN_wrlinux-src-dl = ""
BBFILE_PATTERN_IGNORE_EMPTY_wrlinux-src-dl = "1"

# This should only be incremented on significant changes that will
# cause compatibility issues with other layers
LAYERVERSION_wrlinux-src-dl = "1"
LAYERSERIES_COMPAT_wrlinux-src-dl = "wrl scarthgap"

# We have a pre-populated downloads directory, add to PREMIRRORS
# The git sources saved in wrlinux-src-dl/git, other types of sources
# are saved in foo-dl[-<version>]/downloads
PREMIRRORS:append = " \
     .*://.*/.* file://${LAYERDIR}/git \n \
     git://.*/.* git://${LAYERDIR}/git/MIRRORNAME;protocol=file \n \
     gitsm://.*/.* gitsm://${LAYERDIR}/git/MIRRORNAME;protocol=file \n \
    .*://.*/.* file://${LAYERDIR}/../oe-core-dl-5.0/downloads \n \
    .*://.*/.* file://${LAYERDIR}/../meta-openembedded-dl-5.0/downloads \n \
    .*://.*/.* file://${LAYERDIR}/../meta-anaconda-dl/downloads \n \
    .*://.*/.* file://${LAYERDIR}/../meta-clang-dl/downloads \n \
    .*://.*/.* file://${LAYERDIR}/../meta-browser-dl-5.0/downloads \n \
    .*://.*/.* file://${LAYERDIR}/../meta-secure-core-dl/downloads \n \
    .*://.*/.* file://${LAYERDIR}/../meta-intel-dl/downloads \n \
    .*://.*/.* file://${LAYERDIR}/../meta-intel-qat-dl/downloads \n \
    .*://.*/.* file://${LAYERDIR}/../meta-iot-cloud-dl/downloads \n \
    .*://.*/.* file://${LAYERDIR}/../meta-mingw-dl/downloads \n \
    .*://.*/.* file://${LAYERDIR}/../meta-raspberrypi-dl-5.0/downloads \n \
    .*://.*/.* file://${LAYERDIR}/../meta-security-dl/downloads \n \
    .*://.*/.* file://${LAYERDIR}/../meta-tensorflow-dl-5.0/downloads \n \
    .*://.*/.* file://${LAYERDIR}/../meta-virtualization-dl-5.0/downloads \n \
    .*://.*/.* file://${LAYERDIR}/../meta-cloud-services-dl-5.0/downloads \n \
    .*://.*/.* file://${LAYERDIR}/../meta-xilinx-dl/downloads \n \
    .*://.*/.* file://${LAYERDIR}/../wr-ota-dl/downloads \n \
"

TS_DL_DIR = "${LAYERDIR}/../meta-tensorflow-dl-5.0/distdir"
```
